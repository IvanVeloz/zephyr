## drivers/i2s/Kconfig.sam0
```kconfig
# Atmel SAM I2S bus driver configuration options

# Copyright (c) 2024 Ivan Veloz
# SPDX-License-Identifier: Apache-2.0

menuconfig I2S_SAM0
	bool "Atmel SAM0 MCU family I2S Bus Driver"
	default y
	depends on DT_HAS_ATMEL_SAM0_I2S_ENABLED
	select CACHE_MANAGEMENT if CPU_HAS_DCACHE
	select DMA
	help
	  Enable Inter Sound (I2S) bus driver for Atmel SAM0 MCU family based on
	  the Inter-IC Sound Controller module. (Tested on Arduino Nano 33 IoT)

if I2S_SAM0

config I2S_SAM0_RX_BLOCK_COUNT
	int "RX queue length"
	default 4

config I2S_SAM0_TX_BLOCK_COUNT
	int "TX queue length"
	default 4

endif # I2S_SAM0
```

## dts/bindings/i2s/atmel,sam0-i2s.yaml
```yaml
# Copyright 2024 Ivan Veloz
# SPDX-License-Identifier: Apache-2.0

description: Atmel SAM0 series I2S serializer unit

compatible: "atmel,sam0-i2s"

on-bus: atmel-sam0-i2sc
bus: i2s

include: [i2s-controller.yaml, pinctrl-device.yaml]

properties:

  reg:
    description: "Serializer instance to be used by this node."
    required: true

  secondary-serializer-reg:
    type: int
    description: "A secondary serializer instance (optional). If specified, it is used when I2S_DIR_BOTH is configured (primary serializer's SDm pin will be RX and secondary SDm will be TX)."

  clocks:
    required: true

  clock-names:
    required: true

  pinctrl-0:
    required: true

  pinctrl-names:
    required: true
```

## dts/bindings/i2s/atmel,sam0-i2sc.yaml
```yaml
# Copyright 2024 Ivan Veloz
# SPDX-License-Identifier: Apache-2.0

description: Atmel SAM0 series I2S controller

compatible: "atmel,sam0-i2sc"

bus: atmel-sam0-i2sc

include: [base.yaml, pinctrl-device.yaml]

properties:

  reg:
    required: true

  interrupts:
    required: true

  "#address-cells":
    required: true
    const: 1

  "#size-cells":
    required: true
    const: 0

  pinctrl-0:
    required: true

  pinctrl-names:
    required: true
```
